## meta-am62xx-bsp/conf/machine/include/myir-6252-am62x-uboot.inc
```bitbake
# U-Boot configuration for MYIR-6252-AM62X machine

# Set the default device tree file for U-Boot
UBOOT_DTB = "myir-6252-am62x.dtb"

# Set the TI FDT folder path for device tree location
UBOOT_TI_FDT_FOLDER_PATH = "myir-6252-am62x"

# Configure U-Boot to use the correct device tree
UBOOT_CONFIG_FRAGMENTS:append = " myir-6252-am62x.cfg"

# Set the board name for U-Boot
UBOOT_BOARD_NAME = "myir-6252-am62x"

# Additional U-Boot environment variables
UBOOT_ENVIRONMENT = " \
    myir-6252-am62x.env \
"

# U-Boot boot command configuration
UBOOT_BOOTCOMMAND = "run findfdt; run init_kernel; run run_kernel;"

# Set the default device tree in U-Boot config
UBOOT_EXTRACONFIG = " \
    CONFIG_DEFAULT_FDT_FILE=\"myir-6252-am62x.dtb\" \
    CONFIG_TI_FDT_FOLDER_PATH=\"myir-6252-am62x\" \
"
```

## meta-am62xx-bsp/conf/machine/include/warp-am62x-uboot.inc
```bitbake
# U-Boot configuration for WARP-AM62X machine

# Set the default device tree file for U-Boot
UBOOT_DTB = "warp-am62x.dtb"

# Set the TI FDT folder path for device tree location
UBOOT_TI_FDT_FOLDER_PATH = "warp-am62x"

# Configure U-Boot to use the correct device tree
UBOOT_CONFIG_FRAGMENTS:append = " warp-am62x.cfg"

# Set the board name for U-Boot
UBOOT_BOARD_NAME = "warp-am62x"

# Additional U-Boot environment variables
UBOOT_ENVIRONMENT = " \
    warp-am62x.env \
"

# U-Boot boot command configuration
UBOOT_BOOTCOMMAND = "run findfdt; run init_kernel; run run_kernel;"

# Set the default device tree in U-Boot config
UBOOT_EXTRACONFIG = " \
    CONFIG_DEFAULT_FDT_FILE=\"warp-am62x.dtb\" \
    CONFIG_TI_FDT_FOLDER_PATH=\"warp-am62x\" \
"
```

## meta-am62xx-bsp/conf/machine/mach-am62x.conf
```bitbake
#@TYPE: Machine
#@NAME: AM62XX EVM
#@DESCRIPTION: Machine configuration for the TI AM62XX EVM

require conf/machine/include/mach_am62x.inc
require conf/machine/include/ti-extras.inc

KERNEL_DEVICETREE_PREFIX = "myir/myd-y62x"

KERNEL_DEVICETREE = " \
    myir/myd-y62x-6254.dtb \
"

UBOOT_MACHINE = "myc_am62x_a53_defconfig"
```

## meta-am62xx-bsp/conf/machine/myir-6252-am62x.conf
```bitbake
#@TYPE: Machine
#@NAME: MYIR-6252-AM62X
#@DESCRIPTION: Machine configuration for the MYIR-6252-AM62X board

require conf/machine/include/myir_6252_am62x.inc
require conf/machine/include/ti-extras.inc

KERNEL_DEVICETREE_PREFIX = "myir-6252-am62x/myir-6252-am62x"

KERNEL_DEVICETREE = " \
    myir-6252-am62x/myir-6252-am62x.dtb \
"

UBOOT_MACHINE = "am62x_evm_a53_defconfig"
```

## meta-am62xx-bsp/conf/machine/myir-6254-am62x.conf
```bitbake
#@TYPE: Machine
#@NAME: MYIR-6254-AM62X
#@DESCRIPTION: Machine configuration for the MYIR-6254-AM62X board

require conf/machine/include/myir_6254_am62x.inc
require conf/machine/include/ti-extras.inc

KERNEL_DEVICETREE_PREFIX = "myir-6254-am62x/myir-6254-am62x"

KERNEL_DEVICETREE = " \
    myir-6254-am62x/myir-6254-am62x-6252.dtb \
	myir-6254-am62x/myir-6254-am62x-6254.dtb \
"

UBOOT_MACHINE = "am62x_evm_a53_defconfig"
```

## meta-am62xx-bsp/conf/machine/warp-am62x-k3r5.conf
```bitbake
#@TYPE: Machine
#@NAME: WARP-AM62X (R5F)
#@DESCRIPTION: Machine configuration for the WARP-AM62X board (R5F core)

require conf/machine/include/k3r5.inc
require conf/machine/include/ti-extras.inc

SYSFW_SOC = "am62x"
SYSFW_CONFIG = "evm"
SYSFW_SUFFIX = "gp"
SYSFW_PREFIX= "fs"
UBOOT_MACHINE = "am62x_evm_r5_defconfig"
```

## meta-am62xx-bsp/conf/machine/warp-am62x.conf
```bitbake
#@TYPE: Machine
#@NAME: WARP-AM62X
#@DESCRIPTION: Machine configuration for the WARP-AM62X board

require conf/machine/include/warp_am62x.inc
require conf/machine/include/ti-extras.inc

KERNEL_DEVICETREE_PREFIX = "warp-am62x/warp-am62x"

KERNEL_DEVICETREE = " \
    warp-am62x/warp-am62x.dtb \
"

UBOOT_MACHINE = "am62x_evm_a53_defconfig"
```
